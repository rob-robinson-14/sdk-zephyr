## drivers/sensor/nordic/vbat/Kconfig
```kconfig
# Copyright (c) 2026 Nordic Semiconductor ASA
#
# SPDX-License-Identifier: Apache-2.0

config NRF_VBAT
	bool "nRF battery voltage sensor (nrfx SAADC, not Zephyr ADC driver)"
	default y
	depends on DT_HAS_NORDIC_NRF_VBAT_ENABLED
	depends on !ADC_NRFX_SAADC
	select NRFX_SAADC
	help
	  SAADC is owned directly by this sensor driver via nrfx. You cannot enable
	  the Zephyr nRF SAADC shim (CONFIG_ADC_NRFX_SAADC) at the same time.

	  The ADC channel referenced by io-channels supplies gain, reference,
	  acquisition time, inputs, resolution, and oversampling. Optional
	  min-threshold-mv on the vbat node sets the SAADC low-limit interrupt
	  (see nrf_vbat_below_threshold()).

if NRF_VBAT

config NRF_VBAT_INIT_TIMEOUT_MS
	int "Timeout for SAADC calibration and first sample during init (ms)"
	default 2000
	range 100 60000

config NRF_VBAT_SAMPLE_TIMEOUT_MS
	int "Timeout for sensor_sample_fetch() waiting on SAADC DONE (ms)"
	default 500
	range 10 10000

endif # NRF_VBAT
```

## dts/bindings/sensor/nordic,nrf-vbat.yaml
```yaml
# Copyright (c) 2026 Nordic Semiconductor ASA
#
# SPDX-License-Identifier: Apache-2.0

description: |
  nRF SoC battery voltage measurement via the SAADC (Zephyr ADC driver).
  Reports SENSOR_CHAN_VOLTAGE in volts (sensor_value).

compatible: "nordic,nrf-vbat"

include: sensor-device.yaml

properties:

  min-threshold-mv:
    type: int
    description: |
      Low-voltage threshold in millivolts for application use.
  pselp:
    type: int
    required: true
    description: |
      SAADC positive pin selection for battery voltage measurement from nrfx_analog_input_t.
  pseln:
    type: int
    description: |
      SAADC positive pin selection for battery voltage measurement from nrfx_analog_input_t.
    
  invert-voltage:
    type: boolean
    description: |
      If true, the voltage value is inverted 
      i.e. for use when positive pin used for ground.
```

## soc/nordic/nrf54l/health_monitoring/Kconfig
```kconfig
# Nordic Semiconductor nRF71 MCU line

# Copyright (c) 2025 Nordic Semiconductor ASA
# SPDX-License-Identifier: Apache-2.0

config VBAT_MONITOR_ENABLE
	bool "Enable VBAT monitoring"
	select  SOC_HEALTH_MONITORING

config VINTERNAL_MONITOR_ENABLE
	bool "Enable VInternal monitoring"
	select  SOC_HEALTH_MONITORING

config SOC_HEALTH_MONITORING
    bool "Enable health monitoring system"
	default n
    select ADC
	select SOC_LATE_INIT_HOOK
	# Debug
	select SHELL
	select KERNEL_SHELL
    help
      Enable periodic VBAT voltage monitoring using SAADC.
      When enabled, the application will periodically measure
      the battery voltage and trigger a callback if it falls
      below the configured threshold.


if SOC_HEALTH_MONITORING

config VBAT_MONITOR_INTERVAL_MS
	int "VBAT measurement interval (milliseconds)"
	default 2000
	range 100 3600000
	help
	  Interval between VBAT measurements in milliseconds.
	  Minimum: 100 ms
	  Maximum: 3600000 ms (1 hour)

config VBAT_MONITOR_LOWER_THRESHOLD_MV
	int "VBAT low threshold (millivolts)"
	default 250
	range 200 5000
	help
	  Battery voltage threshold in millivolts. When the measured
	  voltage falls below this value, the low battery callback
	  will be triggered.
	  Typical range: 2000-5000 mV

config VBAT_MONITOR_LOG_LEVEL
	int "VBAT monitor log level"
	default 3
	range 0 4
	help
	  Log level for VBAT monitor module:
	  0 = OFF
	  1 = ERROR
	  2 = WARN
	  3 = INFO
	  4 = DEBUG

endif # VBAT_MONITOR_ENABLE
```

## soc/nordic/nrf54l/health_monitoring_nrfx/Kconfig
```kconfig
# Nordic Semiconductor nRF71 MCU line

# Copyright (c) 2025 Nordic Semiconductor ASA
# SPDX-License-Identifier: Apache-2.0

config VBAT_MONITOR_ENABLE
	bool "Enable VBAT monitoring"
	select  SOC_HEALTH_MONITORING
	select NRFX_SAADC
	# select ADC # TODO: Only enable to verify error in CMakelists.txt


config VINTERNAL_MONITOR_ENABLE
	bool "Enable VInternal monitoring"
	select  SOC_HEALTH_MONITORING

config SOC_HEALTH_MONITORING
	bool "Enable health monitoring system"
	default n
	select SOC_LATE_INIT_HOOK
	# Debug
	select SHELL
	select KERNEL_SHELL
	select LOG
	help
		Enable periodic VBAT voltage monitoring using SAADC.
		When enabled, the application will periodically measure
		the battery voltage and trigger a callback if it falls
		below the configured threshold.

if VBAT_MONITOR_ENABLE

config VBAT_MONITOR_INTERVAL_MS
	int "VBAT measurement interval (milliseconds)"
	default 5000
	range 100 3600000
	help
	  Interval between VBAT measurements in milliseconds.
	  Minimum: 100 ms
	  Maximum: 3600000 ms (1 hour)

config VBAT_MONITOR_LOWER_THRESHOLD_MV
	int "VBAT low threshold (millivolts)"
	default 50
	range 50 5000
	help
	  Battery voltage threshold in millivolts. When the measured
	  voltage falls below this value, the low battery callback
	  will be triggered.
# TODO: Set default and voltage range to expected

endif # VBAT_MONITOR_ENABLE

if SOC_HEALTH_MONITORING

#TODO: Align this with style used elsewhere
config HEALTH_MONITOR_LOG_LEVEL
	int "VBAT monitor log level"
	default 3
	range 0 4
	help
	  Log level for VBAT monitor module:
	  0 = OFF
	  1 = ERROR
	  2 = WARN
	  3 = INFO
	  4 = DEBUG

endif # VBAT_MONITOR_ENABLE
```

## soc/nordic/nrf54l/vtf_monitoring/Kconfig
```kconfig
# Nordic Semiconductor nRF71 MCU line

# Copyright (c) 2025 Nordic Semiconductor ASA
# SPDX-License-Identifier: Apache-2.0

config VBAT_MONITOR_ENABLE
	bool "Enable VBAT monitoring"
	depends on DT_HAS_NORDIC_NRF_VBAT_ENABLED
	select SOC_VTF_MONITORING
	select SENSOR
	select NRF_VBAT


config SOC_VTF_MONITORING
	bool "Enable vtf monitoring system"
	default n
	select SOC_LATE_INIT_HOOK
	# Debug
	select SHELL
	select KERNEL_SHELL
	select LOG
	help
		Enable periodic VBAT voltage monitoring using SAADC.
		When enabled, the application will periodically measure
		the battery voltage and trigger a callback if it falls
		below the configured threshold.

if VBAT_MONITOR_ENABLE

config VBAT_MONITOR_INTERVAL_MS
	int "VBAT measurement interval (milliseconds)"
	default 5000
	range 100 3600000
	help
	  Interval between VBAT measurements in milliseconds.
	  Minimum: 100 ms
	  Maximum: 3600000 ms (1 hour)

endif # VBAT_MONITOR_ENABLE

if SOC_VTF_MONITORING

#TODO: Align this with style used elsewhere
config VTF_MONITOR_LOG_LEVEL
	int "VBAT monitor log level"
	default 3
	range 0 4
	help
	  Log level for VBAT monitor module:
	  0 = OFF
	  1 = ERROR
	  2 = WARN
	  3 = INFO
	  4 = DEBUG

endif # SOC_VTF_MONITORING
```
